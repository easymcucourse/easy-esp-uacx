## examples/common/Kconfig.projbuild
```kconfig
menu "UAC2 example"
    config EXAMPLE_PLAYBACK_TEST
        bool "Run USB DAC playback tests after unit tests"
        default y
        help
            Enumerate a UAC2 DAC using easy_uacx.h and test push/pull PCM
            at every advertised input bit depth and sample rate.
    config EXAMPLE_PLAYBACK_BARS
        int "Twinkle Twinkle bars per PCM matrix entry"
        range 1 4
        default 4
    config EXAMPLE_SOAK_SECONDS
        int "Continuous PCM pull playback after the matrix (seconds, 0 disables)"
        range 0 86400
        default 0
    config EXAMPLE_LIFECYCLE_TEST
        bool "Test init/deinit and heap recovery after the first matrix"
        default y
    config EXAMPLE_CS43131_FS_TEST
        bool "CS43131 (3302:98c2) FS listening test, including the white-noise rates"
        default n
        help
            When a CS43131 dongle connects at Full Speed (S3), play a fixed list
            of cases instead of the matrix: 44.1 kHz at every bit depth, then
            the rates its FS firmware cannot play (PCM16 48/96 kHz silent,
            PCM16 88.2 kHz faint noise, PCM24/32 at 48 kHz and up white noise),
            then 44.1 kHz again. The serial log announces each case and its
            expected sound and prints a ticker while it plays. The noise rates
            are only advertised with EUACX_USE_VERIFIED_CAPS disabled; use
            scripts/idf_playback.ps1 -Board s3 -Profile Cs43131.
    config EXAMPLE_CS43131_TEST_VOLUME_DB
        int "Hardware volume during the CS43131 listening test (dB)"
        depends on EXAMPLE_CS43131_FS_TEST
        range -60 0
        default -20
        help
            The white-noise cases are louder than the melody at the same
            volume; keep headphones at a safe level.
endmenu
```

## examples/mp3_player/sdkconfig.defaults
```kconfig
CONFIG_ESPTOOLPY_FLASHSIZE_4MB=y
CONFIG_PARTITION_TABLE_CUSTOM=y
CONFIG_PARTITION_TABLE_CUSTOM_FILENAME="partitions.csv"

CONFIG_EUACX_NUM_TRANSFERS=4
CONFIG_EUACX_FEED_STACK=16384
CONFIG_USB_HOST_CONTROL_TRANSFER_MAX_SIZE=4096
CONFIG_USB_HOST_HW_BUFFER_BIAS_PERIODIC_OUT=y
CONFIG_ESP_MAIN_TASK_STACK_SIZE=16384
```

## examples/mp3_player/sdkconfig.defaults.esp32s3
```kconfig
CONFIG_USB_HOST_HUBS_SUPPORTED=y
CONFIG_USB_HOST_EXT_PORT_RESET_RECOVERY_DELAY_MS=100
CONFIG_USB_HOST_EXT_PORT_CUSTOM_POWER_ON_DELAY_ENABLE=y
CONFIG_USB_HOST_EXT_PORT_CUSTOM_POWER_ON_DELAY_MS=500
```
