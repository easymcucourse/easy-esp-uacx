## components/easy-esp-uacx/Kconfig
```kconfig
menu "Easy UAC2 playback"
    config EUACX_DRV_REPORTED
        bool "Include device behavior entries supported by public reports"
        default y
    config EUACX_DUMP_DESCRIPTORS
        bool "Log accepted DAC configuration descriptor bytes"
        default n
    config EUACX_DRV_CX31993
        bool "Include CX31993 driver (06cb:1594)"
        default y
    config EUACX_NUM_TRANSFERS
        int "ISO transfers in flight"
        range 2 8
        default 4
    config EUACX_USE_VERIFIED_CAPS
        bool "Use hardware-verified driver capabilities"
        default y
    config EUACX_BUFFER_MS
        int "PCM ring buffer duration (milliseconds)"
        range 10 1000
        default 40
    config EUACX_MAX_ERRORS
        int "Consecutive ISO errors before stopping"
        range 1 100
        default 8
    config EUACX_TASK_STACK
        int "Manager task stack bytes"
        range 4096 32768
        default 8192
    config EUACX_LIB_PRIORITY
        int "USB library task priority"
        range 1 24
        default 20
    config EUACX_PUMP_PRIORITY
        int "USB event pump task priority"
        range 2 24
        default 19
    config EUACX_PUMP_STACK
        int "USB event pump stack bytes"
        range 4096 32768
        default 8192
    config EUACX_INT_QUEUE_LEN
        int "Internal event queue length"
        range 1 128
        default 8
    config EUACX_REQ_QUEUE_LEN
        int "API request queue length"
        range 1 128
        default 8
    config EUACX_REQ_TIMEOUT_MS
        int "API request enqueue timeout milliseconds"
        range 1 60000
        default 2000
    config EUACX_CB_STACK
        int "Callback task stack bytes"
        range 4096 32768
        default 4096
    config EUACX_CB_QUEUE_LEN
        int "Callback queue length"
        range 1 128
        default 16
    config EUACX_FEED_PRIORITY
        int "Pull feed task priority (below pump)"
        range 1 18
        default 10
    config EUACX_FEED_STACK
        int "Pull feed task stack bytes"
        range 4096 32768
        default 8192
    config EUACX_FEED_RETRY_MS
        int "Pull callback retry milliseconds"
        range 1 100
        default 2
    config EUACX_RECOVERY_MS
        int "Retry root enumeration without a DAC (0 disables)"
        range 0 60000
        default 5000
endmenu
```

## components/uac2_host/Kconfig
```kconfig
menu "UAC2 Host"
    config UAC2_PCM
        bool "PCM support"
        default y
    config UAC2_DOP
        bool "DoP support"
        default y
    config UAC2_NATIVE_DSD
        bool "Native DSD support"
        default y
    config UAC2_QUIRK_XMOS
        bool "XMOS quirks"
        default y
    config UAC2_QUIRK_CMEDIA
        bool "C-Media quirks"
        default n
    config UAC2_FEEDBACK
        bool "Async feedback endpoint"
        default y
    config UAC2_NUM_TRANSFERS
        int "ISO transfers in flight"
        range 2 8
        default 3
endmenu
```

## examples/common/Kconfig.projbuild
```kconfig
menu "UAC2 example"
    config EXAMPLE_PLAYBACK_TEST
        bool "Run USB DAC playback tests after unit tests"
        default y
        help
            Enumerate a UAC2 DAC using easy_uacx.h and test push/pull PCM
            at every advertised input bit depth and sample rate.
    config EXAMPLE_PLAYBACK_BARS
        int "Twinkle Twinkle bars per PCM matrix entry"
        range 1 4
        default 4
    config EXAMPLE_SOAK_SECONDS
        int "Continuous PCM pull playback after the matrix (seconds, 0 disables)"
        range 0 86400
        default 0
    config EXAMPLE_LIFECYCLE_TEST
        bool "Test init/deinit and heap recovery after the first matrix"
        default y
endmenu
```

## examples/p4/sdkconfig.defaults
```kconfig
CONFIG_IDF_TARGET="esp32p4"
CONFIG_EUACX_NUM_TRANSFERS=4


CONFIG_ESP_CONSOLE_USB_SERIAL_JTAG=y
CONFIG_ESP_CONSOLE_SECONDARY_NONE=y
CONFIG_USB_HOST_CONTROL_TRANSFER_MAX_SIZE=4096

CONFIG_ESP_MAIN_TASK_STACK_SIZE=16384
```

## examples/player/main/Kconfig.projbuild
```kconfig
menu "Music Player"

    config MUSIC_WIFI_SSID
        string "Wi-Fi SSID"
        default ""
        help
            Station-mode network name. Leave empty to disable Wi-Fi, the web
            interface, and TCP OTA. The generated sdkconfig is ignored by Git.

    config MUSIC_WIFI_PASSWORD
        string "Wi-Fi password"
        default ""
        help
            Station-mode network password. It is stored only in the local
            sdkconfig and compiled firmware; do not add sdkconfig to Git.

endmenu
```

## examples/player/sdkconfig.defaults
```kconfig
CONFIG_IDF_TARGET="esp32s3"

CONFIG_USB_HOST_CONTROL_TRANSFER_MAX_SIZE=2048
CONFIG_MICRO_FLAC_PREFER_PSRAM=y
CONFIG_MICRO_FLAC_ENABLE_XTENSA_ASM=y
# CONFIG_MICRO_FLAC_ENABLE_OGG is not set
CONFIG_USB_HOST_HW_BUFFER_BIAS_PERIODIC_OUT=y
CONFIG_UAC2_NUM_ISOC_URBS=4
CONFIG_UAC2_NUM_PACKETS_PER_URB=1
CONFIG_UAC2_CTRL_XFER_MAX_SIZE=512

CONFIG_ESPTOOLPY_FLASHMODE_DIO=y
CONFIG_ESPTOOLPY_FLASHFREQ_80M=y
CONFIG_ESPTOOLPY_FLASHSIZE_16MB=y
CONFIG_ESPTOOLPY_FLASHSIZE="16MB"

CONFIG_PARTITION_TABLE_CUSTOM=y
CONFIG_PARTITION_TABLE_CUSTOM_FILENAME="partitions.csv"
CONFIG_PARTITION_TABLE_OFFSET=0x8000

CONFIG_SPIRAM=y
CONFIG_SPIRAM_MODE_OCT=y
CONFIG_SPIRAM_TYPE_AUTO=y
CONFIG_SPIRAM_SPEED_80M=y
CONFIG_SPIRAM_CLK_IO=30
CONFIG_SPIRAM_CS_IO=26
CONFIG_SPIRAM_BOOT_INIT=y
CONFIG_SPIRAM_USE_MALLOC=y
CONFIG_SPIRAM_MEMTEST=y
CONFIG_SPIRAM_MALLOC_ALWAYSINTERNAL=16384
CONFIG_SPIRAM_MALLOC_RESERVE_INTERNAL=32768

CONFIG_FATFS_LFN_HEAP=y
CONFIG_FATFS_MAX_LFN=255
CONFIG_FATFS_API_ENCODING_UTF_8=y

CONFIG_ESP_COREDUMP_ENABLE_TO_FLASH=y
CONFIG_ESP_COREDUMP_DATA_FORMAT_ELF=y

CONFIG_ESP_DEFAULT_CPU_FREQ_MHZ_240=y
CONFIG_ESP_DEFAULT_CPU_FREQ_MHZ=240
CONFIG_COMPILER_OPTIMIZATION_PERF=y
CONFIG_FREERTOS_HZ=1000

CONFIG_LWIP_TCPIP_TASK_AFFINITY_CPU0=y

CONFIG_USB_HOST_HUBS_SUPPORTED=y
CONFIG_USB_HOST_HUB_MULTI_LEVEL=y
```

## examples/s3/sdkconfig.defaults
```kconfig
CONFIG_IDF_TARGET="esp32s3"
CONFIG_EUACX_NUM_TRANSFERS=4

CONFIG_USB_HOST_CONTROL_TRANSFER_MAX_SIZE=4096
CONFIG_USB_HOST_HUBS_SUPPORTED=y
CONFIG_USB_HOST_HW_BUFFER_BIAS_PERIODIC_OUT=y

CONFIG_ESP_MAIN_TASK_STACK_SIZE=16384

CONFIG_USB_HOST_EXT_PORT_RESET_RECOVERY_DELAY_MS=100

CONFIG_USB_HOST_EXT_PORT_CUSTOM_POWER_ON_DELAY_ENABLE=y

CONFIG_USB_HOST_EXT_PORT_CUSTOM_POWER_ON_DELAY_MS=500
```
